    // Grupo Oceano
    // Antonia Salazar, Beatriz Toledo, Benjamín Sanchez y Constanza Torres

#define REMOTEXY_MODE__WIFI_POINT
#include <ESP8266WiFi.h>
#include <RemoteXY.h>

    // Nombre del WIFI y contraseña
const char* ssid = "bulbasaur";
const char* password = "pikachu12";
WiFiServer server(80);

    // Pins 
const int PWMA = 15;
const int AIN1 = 14;
const int AIN2 = 12;
const int PWMB = 13;
const int BIN1 = 4;
const int BIN2 = 5;

    // RemoteXY GUI config
#pragma pack(push, 1)  
uint8_t RemoteXY_CONF[] =   // 1604 bytes
  { 255,16,0,0,0,61,6,19,0,0,0,0,16,2,106,200,200,80,7,1,
  0,0,0,0,0,0,20,0,5,6,15,150,150,127,12,52,52,32,186,198,
  31,1,26,18,60,60,46,41,21,21,0,197,244,83,84,79,80,0,1,21,
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  116,111,115,0 };
  

    // Variables provenientes de remoteXY
struct {

  int8_t joystick_x; // desde -100 a 100
  int8_t joystick_y; // desde -100 a 100
  uint8_t STOP; // =1 mientras se aprieta el boton, else =0
  uint8_t TURBO; // =1 mientras se aprieta el boton, else =0
  uint8_t FLIP; // =1 mientras se aprieta el boton, else =0
  int8_t zjoystick_x; // desde -100 a 100
  int8_t zjoystick_y; // desde -100 a 100
  uint8_t zSTOP; // =1 mientras se aprieta el boton, else =0
  uint8_t zTURBO; // =1 mientras se aprieta el boton, else =0
  uint8_t zFLIP; // =1 mientras se aprieta el boton, else =0

} RemoteXY;   

    // Función que permite controlar el PWM entregado a las ruedas según la velocidad entregada por el joystick de la app
void Wheel(unsigned char *motor, int pwrPin, int v) {
  // Limitar el valor de v entre -100 y 100
  if (v > 100) v = 100;
  if (v < -100) v = -100;

  int speed = abs(v) * 2.55; // Convertir el rango de -100 a 100 a 0-255 para PWM

  if (v > 10) { 
    digitalWrite(motor[0], HIGH);   // Adelante
    digitalWrite(motor[1], LOW);
    analogWrite(pwrPin, speed);     // Controlar la velocidad con PWM 
  } 
  else if (v < -10) { 
    digitalWrite(motor[0], LOW);    // Atrás
    digitalWrite(motor[1], HIGH);
    analogWrite(pwrPin, speed);     // Controlar la velocidad con PWM
  } 
  else {
    digitalWrite(motor[0], LOW);    // Parar
    digitalWrite(motor[1], LOW);
    analogWrite(pwrPin, 0);         // Detener el motor
  }
}

unsigned char RightMotor[2] = 
  {AIN1, AIN2};
unsigned char LeftMotor[2] = 
  {BIN1, BIN2};



void ControlMotors(int x, int y) {
  int forward = y;          
  int turn = x;             
  
    // Rango para la sensibilidad de los giros
  if (abs(turn) < 10) {
    turn = 0;                
  } else {
    turn = -0.5 * turn; // bajandole la sensibilidad a los giros 
  }

    // Para aplicar turbo
  float applyturbo = (RemoteXY.TURBO > 0 || RemoteXY.zTURBO > 0) ? 1 : 0.5;

    // Motor derecho
  Wheel(RightMotor, PWMA, applyturbo * (turn/3 - forward));

    // Motor izquierdo
  Wheel(LeftMotor, PWMB, applyturbo * (turn/3 + forward));
}




#pragma pack(pop)
 
void setup() {
  // put your setup code here, to run once:
  {
  remotexy = new CRemoteXY (
    RemoteXY_CONF_PROGMEM, 
    &RemoteXY, 
    new CRemoteXYConnectionServer (
      new CRemoteXYComm_WiFiPoint (
        "bulbasaur",       // REMOTEXY_WIFI_SSID
        "pikachu12"),        // REMOTEXY_WIFI_PASSWORD
      6388                  // REMOTEXY_SERVER_PORT
    )
  ); 
  } 
  
  Serial.begin(115200); // serial monitor
  delay(20);

  // Inicializando pins
  pinMode (AIN1, OUTPUT);
  pinMode (AIN2, OUTPUT);
  pinMode (BIN1, OUTPUT);
  pinMode (BIN2, OUTPUT);

  digitalWrite(AIN1, LOW);
  digitalWrite(AIN2, LOW);
  digitalWrite(BIN1, LOW);
  digitalWrite(BIN2, LOW);
  
  
}

void loop() {
  RemoteXY_Handler();

    // Chequea el boton de STOP previo a hacer funcionar las ruedas
  if (RemoteXY.STOP > 0 || RemoteXY.zSTOP > 0) { 
    Serial.println("STOP");
    digitalWrite(AIN1, LOW);
    digitalWrite(AIN2, LOW);
    digitalWrite(BIN1, LOW);
    digitalWrite(BIN2, LOW);
    analogWrite(PWMA, 0);
    analogWrite(PWMB, 0);
    return;
  }


    // Solo se usará el joystick para zurdos si el para diestros no esta en uso (con un margen de error)
  if (abs(RemoteXY.joystick_x) > 10 || abs(RemoteXY.joystick_y) > 10) {
    ControlMotors(RemoteXY.joystick_x, RemoteXY.joystick_y);
  } else {
    ControlMotors(RemoteXY.zjoystick_x, RemoteXY.zjoystick_y);
  }

  }

